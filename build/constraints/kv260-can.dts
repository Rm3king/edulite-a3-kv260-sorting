/dts-v1/;
/plugin/;
/ {
    fragment@0 {
        target = <&fpga_full>;
        __overlay__ {
            #address-cells = <2>;
            #size-cells = <2>;
            firmware-name = "kv260-can.bit.bin";
            resets = <&zynqmp_reset 116>, <&zynqmp_reset 117>, <&zynqmp_reset 118>, <&zynqmp_reset 119>;
        };
    };
    fragment@1 {
        target = <&amba>;
        __overlay__ {
            #address-cells = <2>;
            #size-cells = <2>;
            kv260_can: can-control@a0000000 {
                compatible = "generic-uio";
                linux,uio-name = "kv260-can";
                /* CAN registers at +0; separate read-only-use FK IP at +64K; vision pre-processing control at +128K. */
                reg = <0x0 0xa0000000 0x0 0x30000>;
                clocks = <&zynqmp_clk 71>;
                assigned-clocks = <&zynqmp_clk 71>;
                assigned-clock-rates = <100000000>;
                status = "okay";
            };
        };
    };
};
